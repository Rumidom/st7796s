/dts-v1/;
/plugin/;

/*
SDI(MOSI)   PH7 SPI1_MOSI
SDO(MISO)   PH8 SPI1_MISO
SCK       	PH6 SPI1_CLK
LCD_CS    	PH5
LCD_RS     	PH4 
LCD_RST     PI0
*/

/ {

	fragment@0 {
		target-path = "/aliases";

		__overlay__ {
			spi1 = "/soc/spi@5011000";
		};
	};

	fragment@1 {
		target = <0xffffffff>;

		__overlay__ {
			status = "okay";
			#address-cells = <0x01>;
			#size-cells = <0x00>;
			pinctrl-names = "default";
			pinctrl-0 = <0xffffffff 0xffffffff 0xffffffff>;
		};
	};

	__fixups__ {
		spi1 = "/fragment@1:target:0";
		spi1_pins = "/fragment@1/__overlay__:pinctrl-0:0";
		spi1_cs0_pin = "/fragment@1/__overlay__:pinctrl-0:4";
		spi1_cs1_pin = "/fragment@1/__overlay__:pinctrl-0:8";
	};
};

/ {
   /* compatible = "allwinner,h616\0arm,sun50iw9p1";*/

    fragment@1 {
	target-path = "/soc/spi@5011000";
	__overlay__ {
	    num-cs = <2>;  
	    status = "okay";
	    #address-cells = <1>;
	    #size-cells = <0>;

	    st7796: st7796s@0{
			compatible = "sitronix,st7796s";
			reg = <0>;
			spi-max-frequency = <16000000>;
			fps = <30>;
			buswidth = <8>;
			reset-gpios = <&pio 8 0 1>;  /* PI0 */
			dc-gpios = <&pio 7 4 0>;     /* PH4 */
			rotate = <0xB4>;
			debug = <1>;
			inversion-on;
            };
	    };
	};
};

